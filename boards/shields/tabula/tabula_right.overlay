#include "tabula.dtsi"

/ {
    kscan0: kscan0 {
        compatible = "zmk,kscan-gpio-matrix";
        diode-direction = "col2row";
        wakeup-source;

        row-gpios
            = <&pro_micro 20 (GPIO_PULL_DOWN | GPIO_ACTIVE_HIGH)>
            , <&pro_micro  3 (GPIO_PULL_DOWN | GPIO_ACTIVE_HIGH)>
            , <&pro_micro  4 (GPIO_PULL_DOWN | GPIO_ACTIVE_HIGH)>
            , <&pro_micro  5 (GPIO_PULL_DOWN | GPIO_ACTIVE_HIGH)>
            , <&pro_micro  6 (GPIO_PULL_DOWN | GPIO_ACTIVE_HIGH)>
            , <&pro_micro  7 (GPIO_PULL_DOWN | GPIO_ACTIVE_HIGH)>
            ;

        col-gpios
            = <&pro_micro 10 GPIO_ACTIVE_HIGH>
            , <&pro_micro 16 GPIO_ACTIVE_HIGH>
            , <&pro_micro 14 GPIO_ACTIVE_HIGH>
            , <&pro_micro 15 GPIO_ACTIVE_HIGH>
            , <&pro_micro 18 GPIO_ACTIVE_HIGH>
            , <&pro_micro 19 GPIO_ACTIVE_HIGH>
            , <&pro_micro  8 GPIO_ACTIVE_HIGH>
            , <&pro_micro  9 GPIO_ACTIVE_HIGH>
            ;
    };
};

&default_transform {
    col-offset = <8>;
};
